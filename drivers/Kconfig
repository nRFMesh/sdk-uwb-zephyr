## drivers/Kconfig
```kconfig
menu "Device Drivers"

rsource "sensor/Kconfig"

rsource "battery/Kconfig"

rsource "dw1000/Kconfig"

endmenu
```

## drivers/dw1000/Kconfig
```kconfig
menuconfig DW1000
	bool "DW1000 Tranceiver"
	help
		Include DW1000 Tranceiver drivers in config
```

## samples/Kconfig
```kconfig
config UWB_SAMPLES_DEFAULTS
	bool "Enable HSM sample default settings"
	default n
	imply LOG
	imply LOG_MINIMAL
	imply ASSERT
	imply ASSERT_NO_COND_INFO
	imply ASSERT_NO_MSG_INFO
	imply HW_STACK_PROTECTION if ARCH_HAS_STACK_PROTECTION
	help
	  Use the default configuration for HSM samples.

if LOG

# LOG_DEFAULT_LEVEL is declared in Zephyr,
# we declare it here for a second time, to set a different default.
# Omit the `prompt` to prevent it from appearing twice in two diffent places.

config LOG_DEFAULT_LEVEL
	default 1 if UWB_SAMPLES_DEFAULTS

endif # LOG

config COMMIT_VAR
    string "the commit"
	default "2af70c8037"
	#git rev-parse HEAD
    #option env="COMMIT_VAR"
```

## subsys/meshposition/Kconfig
```kconfig
menuconfig MESHPOSITION
	bool "Mesh Positioning Remote call library"
	default n
	depends on SIMPLEMESH
	depends on DW1000
	depends on CPLUSPLUS
	help
	  Enable MESHPOSITION functionality.

if MESHPOSITION

	config MP_GPIO_DEBUG
		bool "uwb and ranging gpio debug"
		default n
		help
		Enable gpio debug for uwb and ranging debug

	if MP_GPIO_DEBUG
		config MP_PIN_APP
			int "gpio debug for uwb app"
			default 23
			help
			The default used pin is the DWM1001-Dev kit [nRF] P0.23 => M_PIN16 => J7 pin 7
	endif # MP_GPIO_DEBUG
endif # MESHPOSITION
```

## west.yml
```yaml
manifest:
  version: 0.9
  remotes:
    # Home Smart Mesh GitHub organization.
    - name: uwb
      url-base: https://github.com/nRFMesh
    - name: hsm
      url-base: https://github.com/HomeSmartMesh
    - name: zephyrproject
      url-base: https://github.com/zephyrproject-rtos

  defaults:
    remote: uwb

  projects:
    - name: zephyr
      repo-path: zephyr
      remote: zephyrproject
      revision: 41e885947e4f48aae0866df9e5fee657afb7c1cc
      import:
        name-whitelist:
          - cmsis
          - edtt
          - fatfs
          - hal_nordic
          - libmetal
          - littlefs
          - lvgl
          - mbedtls
          - mcumgr
          - mipi-sys-t
          - net-tools
          - nrf_hw_models
          - openthread
          - segger
    - name: hsm
      repo-path: sdk-hsm-sensortag
      remote: hsm
      revision: d0fc9c481e84451e4d58e4793d8c945fb0b1abc0
      path: modules/lib/simplemesh

  self:
    path: uwb
```
